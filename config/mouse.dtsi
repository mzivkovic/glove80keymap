#define ZMK_MOUSE_DEFAULT_MOVE_VAL 1250
#define ZMK_MOUSE_DEFAULT_SCRL_VAL 100

#include <dt-bindings/zmk/mouse.h>

&mmv {
  acceleration-exponent = <2>;      // 1
  time-to-max-speed-ms = <400>;     // 40
  delay-ms = <0>;                   // 0
};

&msc {
  acceleration-exponent = <1>;      // 0
  time-to-max-speed-ms = <5000>;    // 40
  delay-ms = <0>;                   // 10
};

// Mouse movement macros
#define U_MS_U &mmv MOVE_UP
#define U_MS_D &mmv MOVE_DOWN
#define U_MS_L &mmv MOVE_LEFT
#define U_MS_R &mmv MOVE_RIGHT

// Mouse scroll macros
#define U_WH_U &msc SCRL_UP
#define U_WH_D &msc SCRL_DOWN

// Mouse button macros
#define U_BTN1 &mkp LCLK
#define U_BTN2 &mkp RCLK
#define U_BTN3 &mkp MCLK
