/*
 * Copyright (c) 2020 The ZMK Contributors
 * Copyright (c) 2022 Innaworks Development Limited, trading as MoErgo
 *
 * SPDX-License-Identifier: MIT
 */


/* THIS FILE WAS GENERATED BY GLOVE80 LAYOUT EDITOR
 *
 * This file was generated automatically. You may or may not want to
 * edit it directly.
 */

#include <behaviors.dtsi>
#include <dt-bindings/zmk/outputs.h>

/* Include behaviour includes needed by key binds - automatically generated */
#include <dt-bindings/zmk/keys.h>
#include <dt-bindings/zmk/ext_power.h>
#include <dt-bindings/zmk/bt.h>
#include <dt-bindings/zmk/rgb.h>
#include <dt-bindings/zmk/outputs.h>

#include "./helpers/helper.h"
#include "./helpers/key_positions.h"
#include "./mouse.dtsi"

#define XXX  &none
#define ___  &trans

#define LEFT_HAND_KEYS   LC5 LC4 LC3 LC2 LC1 \
                         LN5 LN4 LN3 LN2 LN1 LN0 \
                         LT5 LT4 LT3 LT2 LT1 LT0 \
                         LM5 LM4 LM3 LM2 LM1 LM0 \
                         LB5 LB4 LB3 LB2 LB1 LB0 \
                         LF5 LF4 LF3 LF2 LF1

#define RIGHT_HAND_KEYS      RC1 RC2 RC3 RC4 RC5 \
                         RN0 RN1 RN2 RN3 RN4 RN5 \
                         RT0 RT1 RT2 RT3 RT4 RT5 \
                         RM0 RM1 RM2 RM3 RM4 RM5 \
                         RB0 RB1 RB2 RB3 RB4 RB5 \
                             RF1 RF2 RF3 RF4 RF5

#define THUMB_KEYS       LH5 LH4 LH3     RH3 RH4 RH5 \
                         LH2 LH1 LH0     RH0 RH1 RH2

#define UNSET_TIMER  (-1)

#define ALPHA  A B C D E F G H I J K L M N O P \
               Q R S T U V W X Y Z

#define NUMERIC  N0 N1 N2 N3 N4 N5 N6 N7 N8 N9


#define MAKE_HRMS(name, hold_tap_flavor, ...) \
    ZMK_BEHAVIOR(hml_ ## name, hold_tap, \
        flavor = hold_tap_flavor; \
        bindings = <&kp>, <&kp>; \
        hold-trigger-key-positions = <RIGHT_HAND_KEYS THUMB_KEYS>; \
        __VA_ARGS__ \
    ) \
    ZMK_BEHAVIOR(hmr_ ## name, hold_tap, \
        flavor = hold_tap_flavor; \
        bindings = <&kp>, <&kp>; \
        hold-trigger-key-positions = <LEFT_HAND_KEYS THUMB_KEYS>; \
        __VA_ARGS__ \
    )


&sk {  // sticky-key config
    quick-release;
};

&caps_word {  // caps word config, requires PR #1742
    no-default-keys;
    continue-list = <ALPHA NUMERIC UNDERSCORE MINUS BACKSPACE DELETE>;
    shift-list = <ALPHA>;
};

/* Custom behaviors/combos/layers */

MAKE_HRMS(homes, "balanced",
    hold-trigger-on-release;  // wait for other home row mods
    tapping-term-ms = <280>;
    quick-tap-ms = <175>;
   require-prior-idle-ms  = <150>;
)
MAKE_HRMS(index, "tap-preferred",
    tapping-term-ms = <180>;
    quick-tap-ms = <300>;
    // no typing streak
)

ZMK_BEHAVIOR(thumb, hold_tap,
    flavor = "balanced";
    bindings = <&mo>, <&kp>;
    tapping-term-ms = <200>;
    quick-tap-ms = <300>;
)

ZMK_BEHAVIOR(thumb_switch, hold_tap,
    flavor = "balanced";
    bindings = <&to>, <&kp>;
    tapping-term-ms = <200>;
    quick-tap-ms = <300>;
)



ZMK_BEHAVIOR(thumb_p, hold_tap,
    flavor = "balanced";
    bindings = <&kp>, <&kp>;
    tapping-term-ms = <200>;
    quick-tap-ms = <300>;
)

ZMK_BEHAVIOR(equal_not_equal, hold_tap,
    flavor = "balanced";
    bindings = <&not_equal>, <&kp>;
    tapping-term-ms = <200>;
    quick-tap-ms = <300>;
)


// tap: sticky-shift | shift + tap/ double-tap: caps-word | hold: shift
ZMK_BEHAVIOR(smart_shft, mod_morph,
    bindings = <&sk LSHFT>, <&caps_word>;
    mods = <(MOD_LSFT)>;
)

// cmd+tab swapper, requires PR #1366
ZMK_BEHAVIOR(macswap, tri_state,
    bindings = <&kt LGUI>, <&kp TAB>, <&kt LGUI>;
    ignored-key-positions = <LM1>;
)

// alt+tab swapper, requires PR #1366
ZMK_BEHAVIOR(winswap, tri_state,
    bindings = <&kt LALT>, <&kp TAB>, <&kt LALT>;
    ignored-key-positions = <LM1>;
)

/* Standard Glove80 behaviors and macros */

// For the "layer" key, it'd nice to be able to use it as either a shift or a toggle.
// Configure it as a tap dance, so the first tap (or hold) is a &mo and the second tap is a &to
ZMK_BEHAVIOR(lower, tap_dance,
    bindings = <&mo 1>, <&to 1>;
    tapping-term-ms = <200>;
)

ZMK_BEHAVIOR(magic, hold_tap,
    flavor = "tap-preferred";
    bindings = <&mo>, <&rgb_ug_status_macro>;
    tapping-term-ms = <200>;
)

ZMK_BEHAVIOR(rgb_ug_status_macro, macro,
    bindings = <&rgb_ug RGB_STATUS>;
)

ZMK_BEHAVIOR(bt_sel, macro_one_param,
    bindings = <&out OUT_BLE>, <&macro_param_1to2>, <&bt BT_SEL MACRO_PLACEHOLDER>;
)

#define BASE       0
#define MAC        1
#define NAVIGATION 2
#define NUMBERS    3
#define SYMBOL     4
#define MOUSE      5
#define MAGIC      6



// h+c for copy
//ZMK_COMBO(copy, &kp LC(C), RM0 LB2, 0, 50)

// f+j for escape
//ZMK_COMBO(esc, &kp ESC, RM1 LM1, 0, 50)

// thumb + J -> to navigation
//ZMK_COMBO(to_navigation, &to NAVIGATION, LH0 RM1, 0, 50)

// " = "
//ZMK_MACRO_3_PRESS(p_equal,SPACE,EQUAL,SPACE)
// " + "
//ZMK_MACRO_3_PRESS(p_plus,SPACE,PLUS,SPACE)
// " - "
//ZMK_MACRO_3_PRESS(p_minus,SPACE,MINUS,SPACE)

// ->
ZMK_MACRO_2_PRESS(pointer,MINUS,GT)
// =>
ZMK_MACRO_2_PRESS(s_pointer,EQUAL,GT)
// !=
ZMK_MACRO_2_PRESS(not_equal,EXCLAMATION,EQUAL)

// ~/.
ZMK_MACRO_3_PRESS(unix_home,TILDE,SLASH,DOT)


CTR_C(copy)
CTR_V(paste)
CTR_X(cut)
ZMK_BEHAVIOR(copy_paste, hold_tap,
    flavor = "balanced";
    bindings = <&paste>, <&copy>;
    tapping-term-ms = <200>;
    quick-tap-ms = <300>;
)

CTRL_Z(undo)
ZMK_MACRO_CTR_C(undo_alt)
ZMK_BEHAVIOR(uno_alt_z, hold_tap,
    flavor = "balanced";
    bindings = <&undo_alt>, <&undo>;
    tapping-term-ms = <200>;
    quick-tap-ms = <300>;
)

ZMK_MACRO_HOLD(mac_copy,LGUI,C)
ZMK_MACRO_HOLD(mac_paste,LGUI,V)
ZMK_MACRO_HOLD(mac_cut,LGUI,X)




SHIFT_MODMORPH(bkpsc_dell,BSPC ,DEL)

ZMK_BEHAVIOR(thumb_bkspc, hold_tap,
    flavor = "balanced";
    bindings = <&mo>, <&bkpsc_dell>;
    tapping-term-ms = <200>;
    quick-tap-ms = <300>;
)

ZMK_MACRO_HOLD(delete_word,LCTRL,BSPC)
ZMK_MACRO_HOLD(delete_word_mac,LALT,BSPC)



#define TO_MAGIC  &magic MAGIC 0
#define IN_SRC    &kp LG(LS(LC(SPACE)))
#define MIC_MUTE  &kp LG(LA(LCTRL))
#define ONEPASS   &kp LG(LS(SPACE))
#define RAYCAST   &kp LG(SPACE)
#define EMOJI     &kp LG(LC(SPACE))
#define SCRNSHT   &kp LG(LS(N4))

GLV80_LAYER(Base,
// ╭───────────────┬────────────────────┬───────────────────┬───────────────────┬─────────────────────╮                     ╭─────────────────────┬───────────────────┬─────────────────────┬───────────────────────┬───────────╮
        &to MAC               XXX               XXX               XXX                 XXX                                           XXX                   XXX                    XXX                  XXX               XXX
// ├───────────────┼────────────────────┼───────────────────┼───────────────────┼─────────────────────┼────────╮   ╭────────┼─────────────────────┼───────────────────┼─────────────────────┼───────────────────────┼───────────┤
       XXX                XXX              &kp LBKT            &kp LBRC             &kp LPAR             &kp LT      &kp GT    &kp RPAR              &kp RBRC             &kp RBKT                    XXX               XXX
// ├───────────────┼────────────────────┼───────────────────┼───────────────────┼─────────────────────┼────────┤   ├────────┼─────────────────────┼───────────────────┼─────────────────────┼───────────────────────┼───────────┤
     &kp TAB         &kp Q                &kp W               &kp E               &kp R                 &kp T        &kp Y       &kp U                 &kp I               &kp O                  &kp P                 XXX
// ├───────────────┼────────────────────┼───────────────────┼───────────────────┼─────────────────────┼────────┤   ├────────┼─────────────────────┼───────────────────┼─────────────────────┼───────────────────────┼───────────┤
      &kp ESC       &hml_homes LCTRL A   &hml_homes  LGUI S  &hml_homes   LALT D &hml_index LSHIFT F    &kp G        &kp H      &hmr_index RSHIFT J    &hmr_homes  LALT K  &hmr_homes  RGUI  L  &hmr_homes RCTRL SEMI   &kp SQT
// ├───────────────┼────────────────────┼───────────────────┼───────────────────┼─────────────────────┼────────┤   ├────────┼─────────────────────┼───────────────────┼─────────────────────┼───────────────────────┼───────────┤
     &to NAVIGATION      &kp Z                &kp X               &kp C               &kp V             &kp B    ,   &kp N         &kp M               &kp COMMA             &kp DOT              &kp COLON             XXX
// ├───────────────┼────────────────────┼───────────────────┼───────────────────┼─────────────────────┼────────╯   ╰────────┼─────────────────────┼───────────────────┼─────────────────────┼───────────────────────┼───────────┤
     TO_MAGIC             XXX               &uno_alt_z 0 0         &cut                &copy                      ,            &kp INS                &kp DEL                 XXX                 XXX                   XXX
// ╰───────────────┴────────────────────┴───────────────────┴───────────────────┴─────────────────────╯                     ╰─────────────────────┴───────────────────┴─────────────────────┴───────────────────────┴───────────╯
                                                                                                                 ,
//                             ╭──────────────────────────┬─────────────────────┬───────────────────────────╮         ╭─────────────────────────────┬───────────────────────────┬─────────────────────╮
                                        &caps_word               &paste                  &delete_word                       &kp PLUS                      &kp MINUS                  &kp UNDER
/*                             ├──────────────────────────┼─────────────────────┼───────────────────────────┤ */ , /* ├─────────────────────────────┼───────────────────────────┼─────────────────────┤ */
                                   &thumb_bkspc NUMBERS 0   &thumb SYMBOL DQT      &thumb NAVIGATION TAB                  &equal_not_equal 0 EQUAL       &kp RET                    &kp SPACE
//                             ╰──────────────────────────┴─────────────────────┴───────────────────────────╯         ╰─────────────────────────────┴───────────────────────────┴─────────────────────╯
)


GLV80_LAYER(MAC,
// ╭────────────┬────────────┬────────────┬────────────┬────────────╮                             ╭────────────┬────────────┬────────────┬────────────┬────────────╮
      &to BASE       ___          ___          ___          ___                                        ___          ___          ___          ___          ___
// ├────────────┼────────────┼────────────┼────────────┼────────────┼────────────╮   ╭────────────┼────────────┼────────────┼────────────┼────────────┼────────────┤
       ___          ___          ___          ___          ___          ___              ___          ___          ___          ___          ___          ___
// ├────────────┼────────────┼────────────┼────────────┼────────────┼────────────┤   ├────────────┼────────────┼────────────┼────────────┼────────────┼────────────┤
       ___          ___          ___          ___          ___          ___              ___          ___          ___          ___          ___          ___
// ├────────────┼────────────┼────────────┼────────────┼────────────┼────────────┤   ├────────────┼────────────┼────────────┼────────────┼────────────┼────────────┤
       ___          ___          ___          ___          ___          ___              ___          ___          ___          ___          ___          ___
// ├────────────┼────────────┼────────────┼────────────┼────────────┼────────────┤   ├────────────┼────────────┼────────────┼────────────┼────────────┼────────────┤
       ___          ___          ___          ___          ___          ___        ,     ___          ___          ___          ___          ___          ___
// ├────────────┼────────────┼────────────┼────────────┼────────────┼────────────╯   ╰────────────┼────────────┼────────────┼────────────┼────────────┼────────────┤
       ___          ___          ___         &mac_cut     &mac_copy                ,                  ___          ___          ___          ___          ___
// ╰────────────┴────────────┴────────────┴────────────┴────────────╯                             ╰────────────┴────────────┴────────────┴────────────┴────────────╯
                                                                                   ,
//                                     ╭────────────┬────────────┬────────────╮         ╭────────────┬────────────┬────────────╮
                                          ___         &mac_paste  &delete_word_mac            ___          ___          ___
/*                                     ├────────────┼────────────┼────────────┤ */ , /* ├────────────┼────────────┼────────────┤ */
                                          ___          ___          ___                    ___          ___          ___
//                                     ╰────────────┴────────────┴────────────╯         ╰────────────┴────────────┴────────────╯
)

GLV80_LAYER(Navigation,
// ╭────────────┬────────────┬────────────┬────────────┬────────────╮                             ╭────────────┬────────────┬────────────┬────────────┬────────────╮
     XXX          XXX          XXX          XXX          XXX                                        XXX          XXX          XXX          XXX          XXX
// ├────────────┼────────────┼────────────┼────────────┼────────────┼────────────╮   ╭────────────┼────────────┼────────────┼────────────┼────────────┼────────────┤
     XXX          XXX          XXX          XXX          XXX          XXX              XXX          XXX          XXX          XXX          XXX          XXX
// ├────────────┼────────────┼────────────┼────────────┼────────────┼────────────┤   ├────────────┼────────────┼────────────┼────────────┼────────────┼────────────┤
     XXX          XXX          XXX          XXX          XXX          XXX              &kp INS       &kp HOME     &kp PG_DN     &kp PG_UP      XXX          XXX
// ├────────────┼────────────┼────────────┼────────────┼────────────┼────────────┤   ├────────────┼────────────┼────────────┼────────────┼────────────┼────────────┤
     XXX          &kp LCTRL     &kp LGUI    &kp LALT     &kp LSHIFT   &to  MOUSE        &kp HOME      &kp LEFT     &kp DOWN      &kp UP     &kp RIGHT        XXX
// ├────────────┼────────────┼────────────┼────────────┼────────────┼────────────┤   ├────────────┼────────────┼────────────┼────────────┼────────────┼────────────┤
     XXX          &cut          XXX           &copy       &paste      &mo  MOUSE   ,   &kp END        XXX         XXX         &kp PG_DN        XXX          XXX
// ├────────────┼────────────┼────────────┼────────────┼────────────┼────────────╯   ╰────────────┼────────────┼────────────┼────────────┼────────────┼────────────┤
     XXX          ___          ___          ___          ___                       ,                XXX          XXX          XXX          XXX          XXX
// ╰────────────┴────────────┴────────────┴────────────┴────────────╯                             ╰────────────┴────────────┴────────────┴────────────┴────────────╯
                                                                                   ,
//                                     ╭────────────┬────────────┬────────────╮         ╭────────────┬────────────┬────────────╮
                                         XXX            XXX          XXX                 &kp F10        &kp F11       &kp F12
/*                                     ├────────────┼────────────┼────────────┤ */ , /* ├────────────┼────────────┼────────────┤ */
                                         &to BASE       XXX         &kp TAB                XXX             XXX        XXX
//                                     ╰────────────┴────────────┴────────────╯         ╰────────────┴────────────┴────────────╯
)

GLV80_LAYER(Numbers,
// ╭──────────┬───────────────┬─────────────┬──────────┬────────────╮                              ╭─────────────────┬──────────────┬─── ───────┬─── ────────┬─────────╮
       ___           ___            ___         ___         ___                                           ___              ___           ___         ___         ___
// ├──────────┼───────────────┼─────────────┼──────────┼────────────┼────────────╮   ╭──────────────┼────────────────┼──────────────┼───────────┼────────────┼─────────┤
       ___           ___            ___         ___         ___          ___              ___             ___              ___           ___         ___         ___
// ├──────────┼───────────────┼─────────────┼──────────┼────────────┼────────────┤   ├──────────────┼────────────────┼──────────────┼───────────┼────────────┼─────────┤
    &kp EQUAL    &kp F1          &kp F2        &kp F3     &kp F4     &kp F5             &kp F6          &kp F7           &kp F8        &kp F9      &kp F10     &kp PLUS
// ├──────────┼───────────────┼─────────────┼──────────┼────────────┼────────────┤   ├──────────────┼────────────────┼──────────────┼───────────┼────────────┼─────────┤
     &kp EQUAL   &kp N1          &kp N2        &kp N3      &kp N4     &kp N5            &kp N6          &kp N7           &kp N8        &kp N9      &kp N0     &kp MINUS
// ├──────────┼───────────────┼─────────────┼──────────┼────────────┼────────────┤   ├──────────────┼────────────────┼──────────────┼───────────┼────────────┼─────────┤
      ___            ___           ___          ___        ___           ___       ,       ___             ___             ___           ___         ___        ___
// ├──────────┼───────────────┼─────────────┼──────────┼────────────┼────────────╯   ╰──────────────┼────────────────┼──────────────┼───────────┼────────────┼─────────┤
      ___            ___         ___            ___        ___                     ,                       ___             ___           ___          ___       ___
// ╰──────────┴───────────────┴─────────────┴──────────┴────────────╯                               ╰────────────────┴──────────────┴───────────┴────────────┴─────────╯
                                                                                   ,
//                                           ╭──────────────┬────────┬────────╮         ╭────────┬─────────┬────────╮
                                                  ___          ___      ___              &kp PLUS &kp MINUS &kp EQUAL
/*                                           ├──────────────┼────────┼────────┤ */ , /* ├────────┼─────────┼────────┤ */
                                                   ___         XXX      ___              ___         ___    &kp SPACE
//                                           ╰──────────────┴────────┴────────╯         ╰────────┴─────────┴────────╯
)



GLV80_LAYER(Symbol,
// ╭────────────┬────────────────┬────────────────┬────────────────┬────────────╮                             ╭────────────────┬────────────────┬──────────────┬────────────┬────────────╮
        XXX           XXX               XXX              XXX            XXX                                         XXX              XXX              XXX           XXX          XXX
// ├────────────┼────────────────┼────────────────┼────────────────┼────────────┼────────────╮   ╭────────────┼────────────────┼────────────────┼──────────────┼────────────┼────────────┤
        XXX           XXX               XXX              XXX            XXX          XXX           &unix_home       XXX              XXX              XXX           XXX          XXX
// ├────────────┼────────────────┼────────────────┼────────────────┼────────────┼────────────┤   ├────────────┼────────────────┼────────────────┼──────────────┼────────────┼────────────┤
        XXX           XXX               XXX              XXX            XXX          XXX            &kp BSLH        XXX              XXX              XXX           XXX          XXX
// ├────────────┼────────────────┼────────────────┼────────────────┼────────────┼────────────┤   ├────────────┼────────────────┼────────────────┼──────────────┼────────────┼────────────┤
        XXX           XXX               XXX         &kp EXCLAMATION   &kp PIPE    &kp CARET         &kp SLASH     &kp TILDE        &kp AT_SIGN        XXX           XXX          XXX
// ├────────────┼────────────────┼────────────────┼────────────────┼────────────┼────────────┤   ├────────────┼────────────────┼────────────────┼──────────────┼────────────┼────────────┤
        XXX           XXX               XXX           &kp HASH        &kp DOLLAR  &kp PERCENT  ,   &kp CARET     &kp AMPERSAND    &kp ASTERISK        XXX           XXX        XXX
// ├────────────┼────────────────┼────────────────┼────────────────┼────────────┼────────────╯   ╰────────────┼────────────────┼────────────────┼──────────────┼────────────┼────────────┤
        XXX            XXX              XXX               XXX           XXX                    ,                       XXX              XXX          XXX          XXX          XXX
// ╰────────────┴────────────────┴────────────────┴────────────────┴────────────╯                             ╰────────────────┴────────────────┴──────────────┴────────────┴────────────╯
                                                                                   ,
//                                     ╭────────────┬────────────┬────────────╮         ╭────────────┬────────────┬────────────╮
                                         XXX          XXX          XXX                     &kp QMARK    &pointer     &s_pointer
/*                                     ├────────────┼────────────┼────────────┤ */ , /* ├────────────┼────────────┼────────────┤ */
                                         XXX          XXX          XXX                    &not_equal       XXX         ___
//                                     ╰────────────┴────────────┴────────────╯         ╰────────────┴────────────┴────────────╯
)

GLV80_LAYER(Mouse,
// ╭────────┬───────────┬──────────┬──────────┬────────────╮                     ╭────────────────┬─────────────────┬──────────────┬─────────────────┬────────╮
     XXX      XXX         XXX        XXX        XXX                                   XXX                 XXX            XXX           XXX               XXX
// ├────────┼───────────┼──────────┼──────────┼────────────┼────────╮   ╭────────┼────────────────┼─────────────────┼──────────────┼─────────────────┼────────┤
     XXX      XXX         XXX        XXX        XXX          XXX          XXX         XXX                    XXX            XXX        XXX               XXX
// ├────────┼───────────┼──────────┼──────────┼────────────┼────────┤   ├────────┼────────────────┼─────────────────┼──────────────┼─────────────────┼────────┤
     XXX      XXX         &kp RALT   XXX        XXX          XXX          XXX         XXX            &msc SCRL_DOWN   &msc SCRL_UP      XXX            XXX
// ├────────┼───────────┼──────────┼──────────┼────────────┼────────┤   ├────────┼────────────────┼─────────────────┼──────────────┼─────────────────┼────────┤
     XXX      &kp LCTRL   &kp LALT   &kp LGUI   &kp LSHIFT   XXX        &to MOUSE   &mmv MOVE_LEFT   &mmv MOVE_DOWN    &mmv MOVE_UP    &mmv MOVE_RIGHT  XXX
// ├────────┼───────────┼──────────┼──────────┼────────────┼────────┤   ├────────┼────────────────┼─────────────────┼──────────────┼─────────────────┼────────┤
     XXX      XXX         XXX        XXX        XXX          XXX      ,   XXX         XXX            XXX                XXX             XXX             XXX
// ├────────┼───────────┼──────────┼──────────┼────────────┼────────╯   ╰────────┼────────────────┼─────────────────┼──────────────┼─────────────────┼────────┤
     XXX      XXX         XXX        XXX        XXX                   ,               XXX                    XXX            XXX       XXX               XXX
// ╰────────┴───────────┴──────────┴──────────┴────────────╯                     ╰────────────────┴─────────────────┴──────────────┴─────────────────┴────────╯
                                                                      ,
//                                    ╭────────┬────────┬────────╮         ╭──────────┬────────┬────────╮
                                        XXX      XXX      XXX                XXX        XXX      XXX
/*                                    ├────────┼────────┼────────┤ */ , /* ├──────────┼────────┼────────┤ */
                                        XXX      XXX      XXX                &to BASE   U_BTN2   U_BTN1
//                                    ╰────────┴────────┴────────╯         ╰──────────┴────────┴────────╯
)

GLV80_LAYER(Magic,
// ╭─────────────┬─────────────────┬─────────────────┬─────────────────┬─────────────────╮                             ╭───────┬───────┬───────┬───────┬────────────────╮
     &bt BT_CLR    XXX               XXX               XXX               XXX                                             XXX     XXX     XXX     XXX     &bt BT_CLR_ALL
// ├─────────────┼─────────────────┼─────────────────┼─────────────────┼─────────────────┼─────────────────╮   ╭───────┼───────┼───────┼───────┼───────┼────────────────┤
     XXX           XXX               XXX               XXX               XXX               XXX                   XXX     XXX     XXX     XXX     XXX     XXX
// ├─────────────┼─────────────────┼─────────────────┼─────────────────┼─────────────────┼─────────────────┤   ├───────┼───────┼───────┼───────┼───────┼────────────────┤
     XXX           &rgb_ug RGB_SPI   &rgb_ug RGB_SAI   &rgb_ug RGB_HUI   &rgb_ug RGB_BRI   &rgb_ug RGB_TOG       XXX     XXX     XXX     XXX     XXX     XXX
// ├─────────────┼─────────────────┼─────────────────┼─────────────────┼─────────────────┼─────────────────┤   ├───────┼───────┼───────┼───────┼───────┼────────────────┤
     &bootloader   &rgb_ug RGB_SPD   &rgb_ug RGB_SAD   &rgb_ug RGB_HUD   &rgb_ug RGB_BRD   &rgb_ug RGB_EFF       XXX     XXX     XXX     XXX     XXX     &bootloader
// ├─────────────┼─────────────────┼─────────────────┼─────────────────┼─────────────────┼─────────────────┤   ├───────┼───────┼───────┼───────┼───────┼────────────────┤
     &sys_reset    XXX               XXX               XXX               XXX               XXX               ,   XXX     XXX     XXX     XXX     XXX     &sys_reset
// ├─────────────┼─────────────────┼─────────────────┼─────────────────┼─────────────────┼─────────────────╯   ╰───────┼───────┼───────┼───────┼───────┼────────────────┤
     XXX           XXX               XXX               XXX               XXX                                 ,           XXX     XXX     XXX     XXX     XXX
// ╰─────────────┴─────────────────┴─────────────────┴─────────────────┴─────────────────╯                             ╰───────┴───────┴───────┴───────┴────────────────╯
                                                                                                             ,
//                                                               ╭───────────┬───────────┬──────────────╮         ╭───────┬───────┬───────╮
                                                                   &bt_sel 2   &bt_sel 3   XXX                      XXX     XXX     XXX
/*                                                               ├───────────┼───────────┼──────────────┤ */ , /* ├───────┼───────┼───────┤ */
                                                                   &bt_sel 0   &bt_sel 1   &out OUT_USB             XXX     XXX     XXX
//                                                               ╰───────────┴───────────┴──────────────╯         ╰───────┴───────┴───────╯
)


// GLV80_LAYER(label,
// // ╭────────────┬────────────┬────────────┬────────────┬────────────╮                             ╭────────────┬────────────┬────────────┬────────────┬────────────╮
//      XXX          XXX          XXX          XXX          XXX                                        XXX          XXX          XXX          XXX          XXX
// // ├────────────┼────────────┼────────────┼────────────┼────────────┼────────────╮   ╭────────────┼────────────┼────────────┼────────────┼────────────┼────────────┤
//      XXX          XXX          XXX          XXX          XXX          XXX              XXX          XXX          XXX          XXX          XXX          XXX
// // ├────────────┼────────────┼────────────┼────────────┼────────────┼────────────┤   ├────────────┼────────────┼────────────┼────────────┼────────────┼────────────┤
//      XXX          XXX          XXX          XXX          XXX          XXX              XXX          XXX          XXX          XXX          XXX          XXX
// // ├────────────┼────────────┼────────────┼────────────┼────────────┼────────────┤   ├────────────┼────────────┼────────────┼────────────┼────────────┼────────────┤
//      XXX          XXX          XXX          XXX          XXX          XXX              XXX          XXX          XXX          XXX          XXX          XXX
// // ├────────────┼────────────┼────────────┼────────────┼────────────┼────────────┤   ├────────────┼────────────┼────────────┼────────────┼────────────┼────────────┤
//      XXX          XXX          XXX          XXX          XXX          XXX          ,   XXX          XXX          XXX          XXX          XXX          XXX
// // ├────────────┼────────────┼────────────┼────────────┼────────────┼────────────╯   ╰────────────┼────────────┼────────────┼────────────┼────────────┼────────────┤
//      XXX          XXX          XXX          XXX          XXX                       ,                XXX          XXX          XXX          XXX          XXX
// // ╰────────────┴────────────┴────────────┴────────────┴────────────╯                             ╰────────────┴────────────┴────────────┴────────────┴────────────╯
//                                                                                    ,
// //                                     ╭────────────┬────────────┬────────────╮         ╭────────────┬────────────┬────────────╮
//                                          XXX          XXX          XXX                    XXX          XXX          XXX
// /*                                     ├────────────┼────────────┼────────────┤ */ , /* ├────────────┼────────────┼────────────┤ */
//                                          XXX          XXX          XXX                    XXX          XXX          XXX
// //                                     ╰────────────┴────────────┴────────────╯         ╰────────────┴────────────┴────────────╯
// )
